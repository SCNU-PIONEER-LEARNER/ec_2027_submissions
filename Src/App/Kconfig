## Src/App/Kconfig
```kconfig
menu "app config"

config APP_USE_CAN
bool "simple CAN"
default n

config APP_USE_RC
bool "simple RC"
default n

endmenu
```

## Src/Common/Extensions/Kconfig
```kconfig
menu "extension config"

config EXTENSION_RC
    bool "remote control"
    default y

config EXTENSION_ET08A
    string "ET08A"
    depends on EXTENSION_RC
    default n

endmenu
```
